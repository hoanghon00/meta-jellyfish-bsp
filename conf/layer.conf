## conf/layer.conf
```bitbake
# We have a conf and classes directory, add to BBPATH
BBPATH .= ":${LAYERDIR}"

# We have recipes-* directories, add to BBFILES
BBFILES += "${LAYERDIR}/recipes-*/*/*.bb \
	${LAYERDIR}/recipes-*/*/*.bbappend"

BBFILE_COLLECTIONS += "jellyfish-bsp"
BBFILE_PATTERN_jellyfish-bsp = "^${LAYERDIR}/"
BBFILE_PRIORITY_jellyfish-bsp = "7"
```
